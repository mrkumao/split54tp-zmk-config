## boards/shields/split54tp/Kconfig.shield
```kconfig
config SHIELD_SPLIT54TP_LEFT
	def_bool $(shields_list_contains,split54tp_left)

config SHIELD_SPLIT54TP_RIGHT
	def_bool $(shields_list_contains,split54tp_right)
```

## config/west.yml
```yaml
# west manifest
#
# ★ バージョン固定について
#   ZMK公式は revision の固定を強く推奨している。
#   https://zmk.dev/blog/2025/06/20/pinned-zmk
#
#   2026-08-31: 初回ビルドが緑になったので main → SHA に固定した。
#     641514a97db345f499dd50b0360e594270f008fe
#
#   固定前に main を追っていた理由:
#     - main は Zephyr 4.1 / HWMv2 へ移行済み (2025-12)
#     - 最新リリース v0.3 は移行前で、ボード名が seeeduino_xiao_ble のまま
#     - 今後のコミュニティモジュールは main 系を前提にすると見込まれる
#
#   ⚠ ZMKを更新したいときの手順:
#       1. git ls-remote https://github.com/zmkfirmware/zmk.git main
#       2. 出力されたSHAで下の revision を置換
#       3. push してビルドが緑になることを確認
#       4. 赤くなったら、このファイルを元のSHAに戻せば即座に復旧できる
#
# ★ トラックポイントについて
#   PS/2版ドライバ (infused-kim) は ZMK本体をフォークに差し替える必要があり、
#   さらにペリフェラル側では動作しないため、いったん外している。
#   低消費電力ポインティングスティック (I2C) に載せ替える方針:
#     https://github.com/sekigon-gonnoc/zmk-driver-lpps
#   導入時は remotes と projects に以下を追加する。
#
#     remotes:
#       - name: sekigon-gonnoc
#         url-base: https://github.com/sekigon-gonnoc
#     projects:
#       - name: zmk-driver-lpps
#         remote: sekigon-gonnoc
#         revision: master
manifest:
  remotes:
    - name: zmkfirmware
      url-base: https://github.com/zmkfirmware
  projects:
    - name: zmk
      remote: zmkfirmware
      revision: 641514a97db345f499dd50b0360e594270f008fe
      import: app/west.yml
  self:
    path: config
```

## dts/bindings/behaviors/zmk,behavior-tp-calib-local.yaml
```yaml
# split54tp 用 (2026-11-04)
# LPPS の強制キャリブレーションを「キーを押した側」の半身で実行する。
# ドライバ同梱の &ps_calib はセントラル (右) でしか動かないため、左右で使えるようにした。

description: LPPS calibration on the half where the key was pressed

compatible: "zmk,behavior-tp-calib-local"

include: zero_param.yaml
```

## dts/bindings/behaviors/zmk,behavior-tp-speed.yaml
```yaml
# split54tp 用 (2026-11-04)
# スティックの感度 (zmk,input-processor-tp-speed) を 1 段ずつ上げ下げする。
#   param1: 0 = 下げる / 1 = 上げる / 2 = 既定に戻す

description: Step the speed of a tp-speed input processor

compatible: "zmk,behavior-tp-speed"

include: one_param.yaml

properties:
  processor:
    type: phandle
    required: true
    description: 対象の zmk,input-processor-tp-speed
```
